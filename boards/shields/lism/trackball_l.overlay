#include <dt-bindings/zmk/input_transform.h>
#include "lism.dtsi"

&spi0 {
    status = "okay";

    tb_left: trackball@0 {
        status = "okay";
        compatible = "pixart,paw3222";
        reg = <0>;
        spi-max-frequency = <2000000>;
        irq-gpios = <&xiao_d 6 (GPIO_ACTIVE_LOW | GPIO_PULL_UP)>;
    };
};

// Overrides for the input-split child node
&left_split {
    device = <&tb_left>;
    input-processors = 
        <&zip_xy_transform (INPUT_TRANSFORM_X_INVERT | INPUT_TRANSFORM_Y_INVERT)>;  
//         <&zip_xy_transform (INPUT_TRANSFORM_X_INVERT | INPUT_TRANSFORM_Y_INVERT)>,
//         <&zip_xy_to_scroll_mapper>;                         //スクロールモードに変更
};